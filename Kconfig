## Kconfig
```kconfig
config ZMK_ANALOG_STICK
	bool "ZMK Analog Stick Driver"
	default y
	depends on DT_HAS_ZMK_ANALOG_STICK_ENABLED
	select ADC
	select GPIO
	select INPUT
	select ZMK_POINTING
	help
	  Multi-mode analog stick driver for ZMK. Reads analog position
	  sensors (TMR, hall-effect, etc.) via io-channels (MCP3208,
	  nRF52840 SAADC, etc.) and emits Zephyr input events. Supports
	  switch, mouse pointer, and scroll modes switchable per keymap
	  layer.

config ZMK_ANALOG_STICK_STICK_COUNT
	int "Maximum number of analog stick instances"
	default 1
	range 1 8
	depends on ZMK_ANALOG_STICK
	help
	  Maximum number of analog stick instances supported. Used to
	  size the scan coordinator's instance registry at compile time.
	  Set to match the number of zmk,analog-stick nodes in your DTS.

config ZMK_ANALOG_STICK_WORK_QUEUE_STACK_SIZE
	int "Analog stick work queue stack size"
	default 3072
	range 1024 8192
	depends on ZMK_ANALOG_STICK
	help
	  Stack size for the dedicated analog stick work queue thread.
	  Default 3072 is sufficient for 8-stick configurations
	  with logging enabled, providing margin for ISR preemption.

config ZMK_ANALOG_STICK_BLE_POLL_FLOOR
	int "BLE poll floor (ms)"
	default 8
	range 1 100
	depends on ZMK_ANALOG_STICK
	help
	  Minimum active poll interval when BLE is enabled. Polling faster
	  than the BLE connection interval wastes power without improving
	  responsiveness. The scan coordinator may raise this floor
	  dynamically based on the negotiated BLE connection interval.

config ZMK_ANALOG_STICK_CI_FLOOR_OVERRIDE
	int "CI floor override (ms)"
	default 0
	range 0 1000
	depends on ZMK_ANALOG_STICK
	help
	  When nonzero, overrides the BLE connection-interval-derived
	  poll floor with this fixed value. Useful for testing or forcing
	  a specific poll rate regardless of the negotiated CI.
	  Set to 0 (default) to use dynamic CI tracking.

config ZMK_ANALOG_STICK_ACTIVE_COOLDOWN_MS
	int "Active poll cooldown (ms)"
	default 250
	range 0 5000
	depends on ZMK_ANALOG_STICK
	help
	  After the stick returns to center, keep polling at the active
	  rate for this many milliseconds before dropping to idle. This
	  ensures rapid successive flicks (e.g. double-tap a direction)
	  are not missed due to the slow idle poll interval.
	  Set to 0 to disable (immediately return to idle polling).

config ZMK_ANALOG_STICK_INIT_PRIORITY
	int "Analog stick init priority"
	default 90
	depends on ZMK_ANALOG_STICK
	help
	  Initialization priority for analog stick devices. Must be after
	  ADC and GPIO device init (POST_KERNEL).

config ZMK_ANALOG_STICK_AUTO_CENTER
	bool "Auto-center calibration at boot"
	default n
	depends on ZMK_ANALOG_STICK
	help
	  Sample the ADC at boot (while the stick is at rest) and use the
	  average as the center point, overriding the devicetree x-center /
	  y-center values. The stick must be centered when the keyboard
	  powers on.

config ZMK_ANALOG_STICK_AUTO_CENTER_SAMPLES
	int "Number of samples for auto-center averaging"
	default 16
	range 4 256
	depends on ZMK_ANALOG_STICK_AUTO_CENTER
	help
	  Number of ADC samples to average when measuring the center point
	  at boot. More samples reduce noise but increase init time.
	  16 samples at ~40us each adds ~640us to boot.

config ZMK_ANALOG_STICK_HID_FLUSH_PER_STICK
	bool "Flush HID report after each stick (no coordinator)"
	default y if !ZMK_SPLIT || ZMK_SPLIT_ROLE_CENTRAL
	default n
	depends on ZMK_ANALOG_STICK
	help
	  When enabled, the input listener flushes the HID accumulator
	  immediately after each stick's mouse/scroll contribution.
	  Enable this for central-side or non-split configurations where
	  the scan coordinator is not calling flush. On peripheral side
	  with scan coordinator, leave disabled (coordinator flushes).

module = ZMK_ANALOG_STICK
module-str = zmk_analog_stick
source "subsys/logging/Kconfig.template.log_config"
```

## dts/bindings/zmk,analog-stick-listener.yaml
```yaml
description: |
  Mode-aware input listener for zmk,analog-stick devices. Routes stick
  input events to switch, mouse, or scroll mode based on the active
  ZMK keymap layer. Configured via child nodes per layer.

compatible: "zmk,analog-stick-listener"

properties:
  device:
    type: phandle
    required: true
    description: Reference to the zmk,analog-stick device to listen to.

child-binding:
  description: Per-layer mode configuration.

  properties:
    layers:
      type: array
      required: true
      description: |
        Array of layer indices this configuration applies to.
        Example: layers = <0 1>;

    mode:
      type: int
      required: true
      description: |
        Input mode for these layers. Use constants from
        dt-bindings/analog-stick/modes.h:
        ANALOG_STICK_MODE_SWITCH (0), ANALOG_STICK_MODE_MOUSE (1),
        ANALOG_STICK_MODE_SCROLL (2).

    up-position:
      type: int
      required: false
      description: Keymap position index for up direction (switch mode).

    down-position:
      type: int
      required: false
      description: Keymap position index for down direction (switch mode).

    left-position:
      type: int
      required: false
      description: Keymap position index for left direction (switch mode).

    right-position:
      type: int
      required: false
      description: Keymap position index for right direction (switch mode).

    switch-activation-point:
      type: int
      default: 40
      description: |
        Threshold for switch mode activation in rescaled output units [0-127].
        When the axis value exceeds this threshold, a key press is generated.

    switch-hysteresis:
      type: int
      default: 4
      description: |
        Hysteresis band for switch mode deactivation. Key release occurs
        when value drops below (activation-point - hysteresis).

    mouse-min-speed:
      type: int
      default: 1
      description: Minimum cursor speed in pixels per poll cycle (mouse mode).

    mouse-max-speed:
      type: int
      default: 15
      description: Maximum cursor speed in pixels per poll cycle (mouse mode).

    scroll-divisor:
      type: int
      default: 4
      description: |
        Scroll rate divisor (scroll mode). Higher values produce slower
        scrolling. The deflection magnitude is divided by this value
        to determine scroll ticks per poll cycle.
```

## dts/bindings/zmk,analog-stick-split-packed.yaml
```yaml
include: [base.yaml]

compatible: "zmk,analog-stick-split-packed"

description: |
  ZMK analog stick packed split transport — coalesces all stick axis
  changes into one BLE notification per scan cycle. Use for 5-8 stick
  configurations. Requires matching packed transport on central.

properties:
  reg:
    required: true

  device:
    type: phandle
    description: |
      Reference to the zmk,analog-stick device (peripheral side only).
      Not needed on the central side.

  pack-version:
    type: int
    default: 1
    description: Packed format version for compatibility checking.
```

## dts/bindings/zmk,analog-stick-split.yaml
```yaml
include: [base.yaml]

compatible: "zmk,analog-stick-split"

description: |
  Wires an analog stick input device for split keyboard use.
  On peripheral: subscribes to input events and forwards over BLE.
  On central: receives forwarded events and re-emits on a proxy device
  for the local input listener to process.

properties:
  reg:
    required: true

  device:
    type: phandle
    description: |
      Reference to the zmk,analog-stick device (peripheral side only).
      Not needed on the central side.
```

## dts/bindings/zmk,analog-stick.yaml
```yaml
description: |
  Multi-mode analog stick driver for ZMK. Reads analog position sensors
  (TMR, hall-effect, etc.) via Zephyr ADC io-channels and emits input
  events. Compatible with any Zephyr ADC driver (MCP3208, nRF52840
  SAADC, etc.).

compatible: "zmk,analog-stick"

properties:
  io-channels:
    type: phandle-array
    required: true
    description: |
      ADC channel references. Index 0 = X axis (required).
      Index 1 = Y axis (optional, omit for single-axis trigger/paddle).
      Example: io-channels = <&mcp3208_0 0>, <&mcp3208_0 1>;

  x-min:
    type: int
    required: true
    description: Raw ADC value at minimum X deflection (calibration).

  x-center:
    type: int
    required: true
    description: Raw ADC value at X center/rest position (calibration).

  x-max:
    type: int
    required: true
    description: Raw ADC value at maximum X deflection (calibration).

  y-min:
    type: int
    default: 0
    description: Raw ADC value at minimum Y deflection (only used with dual-axis).

  y-center:
    type: int
    default: 0
    description: Raw ADC value at Y center/rest position (only used with dual-axis).

  y-max:
    type: int
    default: 0
    description: Raw ADC value at maximum Y deflection (only used with dual-axis).

  deadzone:
    type: int
    default: 50
    description: |
      Per-axis linear deadzone in raw ADC units. Values within this
      distance of center are treated as zero. Applied independently
      to each axis in rescale_axis().

  invert-x:
    type: boolean
    description: Invert X axis output (negate after rescaling).

  invert-y:
    type: boolean
    description: Invert Y axis output (negate after rescaling).

  wait-period-idle:
    type: int
    default: 100
    description: Poll interval in ms when stick is at center (idle).

  wait-period-active:
    type: int
    default: 1
    description: Poll interval in ms when stick is deflected (active).

  enable-gpios:
    type: phandle-array
    description: |
      GPIO for sensor power control. Sticks sharing the same GPIO are
      grouped by the scan coordinator for a single settling wait per
      group, reducing total scan time.

  pulse-read:
    type: boolean
    description: |
      Toggle sensor power per read cycle. Requires enable-gpios.
      Reduces idle power by duty-cycling sensor power.

  read-turn-on-time:
    type: int
    default: 100
    description: |
      Sensor settling time in microseconds after asserting enable GPIO.
      Default 100µs is appropriate for TMR sensors. Hall-effect users
      should set 1000-5000µs per their sensor datasheet (e.g.
      read-turn-on-time = <5000>).

  inter-channel-settling-time:
    type: int
    default: 40
    description: |
      Inter-channel settling time in microseconds between X and Y ADC reads.
      nRF52840 SAADC requires 40µs minimum; MCP3208 needs only ~5µs.
      Tune per hardware to minimize scan time without corrupting readings.

  filter-coefficients:
    type: array
    description: |
      IIR biquad filter coefficients as 6 raw IEEE-754 uint32 hex
      representations (b0, b1, b2, a0, a1, a2). a0 must be 1.0
      (normalized, hex 0x3F800000). Omit to disable filtering.
      Example (2nd-order Butterworth LPF, 25Hz cutoff at 125Hz/8ms poll):
        filter-coefficients = <0x3D8A3D71 0x3E0A3D71 0x3D8A3D71
                                0x3F800000 0xBF927DBD 0x3ED32C9C>;
      Coefficients must be recalculated for poll rates other than 8ms.
```
